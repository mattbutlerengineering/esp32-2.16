## launcher/main/Kconfig.projbuild
```kconfig
menu "Orb Configuration"

config ORB_WIFI_SSID
    string "WiFi SSID"
    default ""
    help
        WiFi network the Orb joins to reach the Bridge. Leave blank to stay
        offline (the device falls back to the local audio echo loopback).
        Seeded into NVS on first boot; later changes here re-seed NVS.

config ORB_WIFI_PASSWORD
    string "WiFi password"
    default ""
    help
        Password for the WiFi network above. Stored in NVS, never in source.

config ORB_BRIDGE_URL
    string "Bridge base URL"
    default "http://192.168.1.100:8080"
    help
        Base URL of the Gemini Bridge. The device POSTs captured audio to
        <url>/talk and plays back the spoken reply.

endmenu
```

## launcher/sdkconfig.defaults
```kconfig
# Defaults for the Orb Launcher on ESP32-S3R8 (8MB octal PSRAM, 16MB flash).
CONFIG_IDF_TARGET="esp32s3"

# Flash
CONFIG_ESPTOOLPY_FLASHSIZE_16MB=y

# Octal PSRAM (R8) — LVGL framebuffer lives here
CONFIG_SPIRAM=y
CONFIG_SPIRAM_MODE_OCT=y
CONFIG_SPIRAM_SPEED_80M=y

# Reasonable defaults
CONFIG_FREERTOS_HZ=1000
CONFIG_ESP_MAIN_TASK_STACK_SIZE=8192
```
